## conf/distro/visionsom-linux.conf
```bitbake
require conf/distro/poky.conf

DISTRO = "visionsom-linux"
DISTRO_NAME = "VisionSOM Linux"
DISTRO_VERSION = "1.0"
DISTROOVERRIDES = "fslc"

# Remove conflicting backends.
DISTRO_FEATURES_remove = "x11 wayland directfb vulkan opengl alsa"
```

## conf/layer.conf
```bitbake
# We have a conf and classes directory, add to BBPATH
BBPATH .= ":${LAYERDIR}"

# We have recipes-* directories, add to BBFILES
BBFILES += "${LAYERDIR}/recipes-*/*/*.bb \
            ${LAYERDIR}/recipes-*/*/*.bbappend"

BBFILE_COLLECTIONS += "meta-somlabs-demo"
BBFILE_PATTERN_meta-somlabs-demo = "^${LAYERDIR}/"
BBFILE_PRIORITY_meta-somlabs-demo = "15"

LAYERSERIES_COMPAT_meta-somlabs-demo = "warrior zeus dunfell"
```
